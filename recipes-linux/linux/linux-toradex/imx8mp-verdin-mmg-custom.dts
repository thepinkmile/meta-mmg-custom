// SPDX-License-Identifier: GPL-2.0-or-later OR MIT
/*
 * Copyright 2024 The Pink Mile
 */

/dts-v1/;

#include "imx8mp-verdin.dtsi"
#include "imx8mp-verdin-wifi.dtsi"
#include "imx8mp-verdin-mmg-custom.dtsi"

/ {
	model = "Toradex Verdin iMX8M Plus WB on Custom Carrier Board";
	compatible = "toradex,verdin-imx8mp-wifi",
				 "toradex,verdin-imx8mp",
				 "fsl,imx8mp";
};