## conf/layer.conf
```bitbake
BBPATH .= ":${LAYERDIR}"

BBFILES += "${LAYERDIR}/recipes-*/*/*.bb \
            ${LAYERDIR}/recipes-*/*/*.bbappend"

BBFILE_COLLECTIONS += "meta-mmg-custom"
BBFILE_PATTERN_meta-mmg-custom = "^${LAYERDIR}/"
BBFILE_PRIORITY_meta-mmg-custom = "23"

LAYERDEPENDS_meta-mmg-custom = " \
	toradex-nxp-layer \
	meta-toradex-security \
"
LAYERSERIES_COMPAT_meta-mmg-custom = "kirkstone"

include conf/machine/verdin-imx8mp-extra.conf
```
